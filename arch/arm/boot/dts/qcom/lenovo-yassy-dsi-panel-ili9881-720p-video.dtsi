/* Copyright (c) 2013, The Linux Foundation. All rights reserved.
 *
 * This program is free software; you can redistribute it and/or modify
 * it under the terms of the GNU General Public License version 2 and
 * only version 2 as published by the Free Software Foundation.
 *
 * This program is distributed in the hope that it will be useful,
 * but WITHOUT ANY WARRANTY; without even the implied warranty of
 * MERCHANTABILITY or FITNESS FOR A PARTICULAR PURPOSE.  See the
 * GNU General Public License for more details.
 */

/*---------------------------------------------------------------------------
 * This file is autogenerated file using gcdb parser. Please do not edit it.
 * Update input XML file to add a new entry or update variable in this file
 * VERSION = "1.0"
 *---------------------------------------------------------------------------*/
&mdss_mdp {
	dsi_ili9881_yassy_720p_video: qcom,mdss_dsi_ili9881_yassy_720p_video {
		qcom,mdss-dsi-panel-name = "ili9881 yassy 720p video mode dsi panel";
		qcom,mdss-dsi-panel-controller = <&mdss_dsi0>;
		qcom,mdss-dsi-panel-type = "dsi_video_mode";
		qcom,mdss-dsi-panel-destination = "display_1";
		qcom,mdss-dsi-panel-framerate = <60>;
		qcom,mdss-dsi-virtual-channel-id = <0>;
		qcom,mdss-dsi-stream = <0>;
		qcom,mdss-dsi-panel-width = <720>;
		qcom,mdss-dsi-panel-height = <1280>;
		qcom,mdss-dsi-h-front-porch = <150>;
		qcom,mdss-dsi-h-back-porch = <150>;
		qcom,mdss-dsi-h-pulse-width = <10>;
		qcom,mdss-dsi-h-sync-skew = <0>;
		qcom,mdss-dsi-v-back-porch = <19>;
		qcom,mdss-dsi-v-front-porch = <20>;
		qcom,mdss-dsi-v-pulse-width = <2>;
		qcom,mdss-dsi-h-left-border = <0>;
		qcom,mdss-dsi-h-right-border = <0>;
		qcom,mdss-dsi-v-top-border = <0>;
		qcom,mdss-dsi-v-bottom-border = <0>;
		qcom,mdss-dsi-bpp = <24>;
		qcom,mdss-dsi-underflow-color = <0xff>;
		qcom,mdss-dsi-border-color = <0>;
		qcom,mdss-dsi-on-command = [	39 01 00 00 00 00 04 FF 98 81 07
			39 01 00 00 00 00 02 03 20
			39 01 00 00 00 00 02 04 06
			39 01 00 00 00 00 02 05 00
			39 01 00 00 00 00 02 06 01
			39 01 00 00 00 00 02 07 00
			39 01 00 00 00 00 02 08 00
			39 01 00 00 00 00 02 09 00
			39 01 00 00 00 00 02 0a 00
			39 01 00 00 00 00 02 0b 2f
			39 01 00 00 00 00 02 0c 00
			39 01 00 00 00 00 02 0d 00
			39 01 00 00 00 00 02 0e 00
			39 01 00 00 00 00 02 0f 00
			39 01 00 00 00 00 02 10 40
			39 01 00 00 00 00 02 11 02
			39 01 00 00 00 00 02 12 05
			39 01 00 00 00 00 02 13 00
			39 01 00 00 00 00 02 14 00
			39 01 00 00 00 00 02 15 00
			39 01 00 00 00 00 02 16 2f
			39 01 00 00 00 00 02 17 2f
			39 01 00 00 00 00 02 18 00
			39 01 00 00 00 00 02 19 00
			39 01 00 00 00 00 02 1a 00
			39 01 00 00 00 00 02 1b 50
			39 01 00 00 00 00 02 1c Bc
			39 01 00 00 00 00 02 1d 0C
			39 01 00 00 00 00 02 1e 00
			39 01 00 00 00 00 02 1f 00
			39 01 00 00 00 00 02 20 00
			39 01 00 00 00 00 02 21 00
			39 01 00 00 00 00 02 22 00
			39 01 00 00 00 00 02 23 C0
			39 01 00 00 00 00 02 24 30
			39 01 00 00 00 00 02 25 00
			39 01 00 00 00 00 02 26 00
			39 01 00 00 00 00 02 27 03
			39 01 00 00 00 00 02 30 01
			39 01 00 00 00 00 02 31 23
			39 01 00 00 00 00 02 32 45
			39 01 00 00 00 00 02 33 67
			39 01 00 00 00 00 02 34 89
			39 01 00 00 00 00 02 35 ab
			39 01 00 00 00 00 02 36 01
			39 01 00 00 00 00 02 37 23
			39 01 00 00 00 00 02 38 45
			39 01 00 00 00 00 02 39 67
			39 01 00 00 00 00 02 3a 89
			39 01 00 00 00 00 02 3b ab
			39 01 00 00 00 00 02 3c cd
			39 01 00 00 00 00 02 3d ef
			39 01 00 00 00 00 02 50 11
			39 01 00 00 00 00 02 51 06
			39 01 00 00 00 00 02 52 0c
			39 01 00 00 00 00 02 53 0d
			39 01 00 00 00 00 02 54 0e
			39 01 00 00 00 00 02 55 0f
			39 01 00 00 00 00 02 56 02
			39 01 00 00 00 00 02 57 02
			39 01 00 00 00 00 02 58 02
			39 01 00 00 00 00 02 59 02
			39 01 00 00 00 00 02 5a 02
			39 01 00 00 00 00 02 5b 02
			39 01 00 00 00 00 02 5c 02
			39 01 00 00 00 00 02 5d 02
			39 01 00 00 00 00 02 5e 02
			39 01 00 00 00 00 02 5f 02
			39 01 00 00 00 00 02 60 05
			39 01 00 00 00 00 02 61 05
			39 01 00 00 00 00 02 62 05
			39 01 00 00 00 00 02 63 02
			39 01 00 00 00 00 02 64 01
			39 01 00 00 00 00 02 65 00
			39 01 00 00 00 00 02 66 08
			39 01 00 00 00 00 02 67 08
			39 01 00 00 00 00 02 68 0c
			39 01 00 00 00 00 02 69 0d
			39 01 00 00 00 00 02 6a 0e
			39 01 00 00 00 00 02 6b 0F
			39 01 00 00 00 00 02 6c 02
			39 01 00 00 00 00 02 6d 02
			39 01 00 00 00 00 02 6e 02
			39 01 00 00 00 00 02 6f 02
			39 01 00 00 00 00 02 70 02
			39 01 00 00 00 00 02 71 02
			39 01 00 00 00 00 02 72 02
			39 01 00 00 00 00 02 73 02
			39 01 00 00 00 00 02 74 02
			39 01 00 00 00 00 02 75 02
			39 01 00 00 00 00 02 76 05
			39 01 00 00 00 00 02 77 05
			39 01 00 00 00 00 02 78 05
			39 01 00 00 00 00 02 79 02
			39 01 00 00 00 00 02 7a 01
			39 01 00 00 00 00 02 7b 00
			39 01 00 00 00 00 02 7c 06
			39 01 00 00 00 00 04 FF 98 81 08
			39 01 00 00 00 00 02 76 b4
			39 01 00 00 00 00 02 78 02
			39 01 00 00 00 00 02 74 2b
			39 01 00 00 00 00 02 8E 15
			39 01 00 00 00 00 02 40 01
			39 01 00 00 00 00 02 7B 04
			39 01 00 00 00 00 02 72 25
			39 01 00 00 00 00 02 87 3A
			39 01 00 00 00 00 02 7E 4C
			39 01 00 00 00 00 02 6C 05
			39 01 00 00 00 00 02 49 10
			39 01 00 00 00 00 02 2D 80
			39 01 00 00 00 00 02 50 65
			39 01 00 00 00 00 02 53 29
			39 01 00 00 00 00 02 54 65
			39 01 00 00 00 00 02 55 38
			39 01 00 00 00 00 02 57 47
			39 01 00 00 00 00 02 58 47
			39 01 00 00 00 00 04 FF 98 81 01
			39 01 00 00 00 00 02 22 0A
			39 01 00 00 00 00 02 31 00
			39 01 00 00 00 00 02 53 8D
			39 01 00 00 00 00 02 55 78
			39 01 00 00 00 00 02 50 A5
			39 01 00 00 00 00 02 51 A7
			39 01 00 00 00 00 02 A0 00
			39 01 00 00 00 00 02 A1 09
			39 01 00 00 00 00 02 A2 13
			39 01 00 00 00 00 02 A3 0C
			39 01 00 00 00 00 02 A4 0E
			39 01 00 00 00 00 02 A5 1E
			39 01 00 00 00 00 02 A6 12
			39 01 00 00 00 00 02 A7 17
			39 01 00 00 00 00 02 A8 68
			39 01 00 00 00 00 02 A9 1C
			39 01 00 00 00 00 02 AA 29
			39 01 00 00 00 00 02 AB 74
			39 01 00 00 00 00 02 AC 1B
			39 01 00 00 00 00 02 AD 19
			39 01 00 00 00 00 02 AE 4D
			39 01 00 00 00 00 02 AF 21
			39 01 00 00 00 00 02 B0 2A
			39 01 00 00 00 00 02 B1 58
			39 01 00 00 00 00 02 B2 67
			39 01 00 00 00 00 02 B3 3F
			39 01 00 00 00 00 02 C0 00
			39 01 00 00 00 00 02 C1 08
			39 01 00 00 00 00 02 C2 13
			39 01 00 00 00 00 02 C3 0C
			39 01 00 00 00 00 02 C4 0D
			39 01 00 00 00 00 02 C5 1E
			39 01 00 00 00 00 02 C6 13
			39 01 00 00 00 00 02 C7 17
			39 01 00 00 00 00 02 C8 67
			39 01 00 00 00 00 02 C9 1C
			39 01 00 00 00 00 02 CA 29
			39 01 00 00 00 00 02 CB 74
			39 01 00 00 00 00 02 CC 1B
			39 01 00 00 00 00 02 CD 1A
			39 01 00 00 00 00 02 CE 4E
			39 01 00 00 00 00 02 CF 21
			39 01 00 00 00 00 02 D0 2A
			39 01 00 00 00 00 02 D1 59
			39 01 00 00 00 00 02 D2 68
			39 01 00 00 00 00 02 D3 3F
			39 01 00 00 00 00 04 FF 98 81 00
			39 01 00 00 00 00 02 51 00
			39 01 00 00 00 00 02 53 2c
			39 01 00 00 00 00 02 55 00
			37 01 00 00 00 00 02 01 00
			05 01 00 00 78 00 02 11 00
			05 01 00 00 00 00 02 29 00];
		qcom,mdss-dsi-off-command = [	05 01 00 00 0a 00 02 28 00
			05 01 00 00 96 00 02 10 00];
		qcom,mdss-dsi-on-command-state = "dsi_lp_mode";
		qcom,mdss-dsi-off-command-state = "dsi_hs_mode";
		qcom,mdss-dsi-h-sync-pulse = <1>;
		qcom,mdss-dsi-traffic-mode = "burst_mode";
		qcom,mdss-dsi-lane-map = "lane_map_0123";
		qcom,mdss-dsi-bllp-eof-power-mode;
		qcom,mdss-dsi-bllp-power-mode;
		qcom,mdss-dsi-lane-0-state;
		qcom,mdss-dsi-lane-1-state;
		qcom,mdss-dsi-lane-2-state;
		qcom,mdss-dsi-lane-3-state;
		qcom,mdss-dsi-panel-timings = [8d 24 19 00 34 34 1d 26 2a 03 04 00];
		qcom,mdss-dsi-t-clk-post = <0x1f>;
		qcom,mdss-dsi-t-clk-pre = <0x2d>;
		qcom,mdss-dsi-dma-trigger = "trigger_sw";
		qcom,mdss-dsi-mdp-trigger = "none";
		qcom,mdss-dsi-reset-sequence = <1 5>, <0 2>, <1 10>;
		qcom,mdss-dsi-lp11-init;
		qcom,cont-splash-enabled;
	};
};
