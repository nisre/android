/* Copyright (c) 2013-2014, The Linux Foundation. All rights reserved.
 *
 * This program is free software; you can redistribute it and/or modify
 * it under the terms of the GNU General Public License version 2 and
 * only version 2 as published by the Free Software Foundation.
 *
 * This program is distributed in the hope that it will be useful,
 * but WITHOUT ANY WARRANTY; without even the implied warranty of
 * MERCHANTABILITY or FITNESS FOR A PARTICULAR PURPOSE.  See the
 * GNU General Public License for more details.
 */

/*---------------------------------------------------------------------------
 * This file is autogenerated file using gcdb parser. Please do not edit it.
 * Update input XML file to add a new entry or update variable in this file
 * VERSION = "1.0"
 *---------------------------------------------------------------------------*/
&mdss_mdp {
	dsi_jdi_1080_vid: qcom,mdss_dsi_jdi_1080p_video {
		qcom,mdss-dsi-panel-name = "zhl 1080p video mode dsi panel";
		qcom,mdss-dsi-panel-controller = <&mdss_dsi0>;
		qcom,mdss-dsi-panel-type = "dsi_video_mode";
		qcom,mdss-dsi-panel-destination = "display_1";
		qcom,mdss-dsi-panel-framerate = <60>;
		qcom,mdss-dsi-virtual-channel-id = <0>;
		qcom,mdss-dsi-stream = <0>;
		qcom,mdss-dsi-panel-width = <540>;
		qcom,mdss-dsi-panel-height = <960>;
		qcom,mdss-dsi-h-front-porch = <47>;
		qcom,mdss-dsi-h-back-porch = <47>;
		qcom,mdss-dsi-h-pulse-width = <47>;
		qcom,mdss-dsi-h-sync-skew = <0>;
		qcom,mdss-dsi-v-back-porch = <16>;
		qcom,mdss-dsi-v-front-porch = <25>;
		qcom,mdss-dsi-v-pulse-width = <2>;
		qcom,mdss-dsi-h-left-border = <0>;
		qcom,mdss-dsi-h-right-border = <0>;
		qcom,mdss-dsi-v-top-border = <0>;
		qcom,mdss-dsi-v-bottom-border = <0>;
		qcom,mdss-dsi-bpp = <24>;
		qcom,mdss-dsi-underflow-color = <0xff>;
		qcom,mdss-dsi-border-color = <0>;
		qcom,mdss-dsi-on-command = [
				39 01 00 00 01 00 04
 					B9 FF 83 89
 				39 01 00 00 01 00 08
					BA 41 93 00
					16 A4 10 18
 				39 01 00 00 00 00 02
					C6 08
 				05 01 00 00 00 00 02
					38 00
 				05 01 00 00 00 00 02
					20 00
 				05 01 00 00 00 00 02
					13 00
				39 01 00 00 0A 00 14
					B1 00 00 07
					EF 97 10 11
					94 F1 26 2E
					3F 3F 42 01
					32 F7 20 80
				39 01 00 00 00 00 04
					DE 05 58 10
				39 01 00 00 01 00 08
					B2 00 00 78
					0E 03 3F 80
				//39 01 00 00 00 00 04
				//	B7 00 00 59
				39 01 00 00 0A 00 18
					B4 80 08 00 
					32 10 07 32 
					10 07 32 10 
					07 27 01 5A 
					0B 37 05 42
					14 FF 5B 0A 
				39 01 00 00 0A 00 31
					D5 00 00 00 
					00 01 00 00 
					00 60 00 99 
					88 88 88 88 
					23 88 01 88
					67 88 45 01 
					23 23 88 88 
					88 88 88 99 
					88 88 88 54 
					88 76 88 10
					88 32 32 10 
					88 88 88 88 
					88 
				39 01 00 00 05 00 23
					E0 01 1C 22 
					34 32 3F 30 
					48 06 0D 11 
					14 17 15 17 
					1A 19 01 1C
					22 34 32 3F 
					30 48 06 0D 
					11 14 17 15 
					17 1A 19  
				39 01 00 00 01 00 80
			   		C1 00 00 08 
			   		0D 15 1C 24 
			   		2E 34 3F 48 
			   		50 58 60 69 
			  	 	70 78 80 88
			  		90 98 A0 A8 
			   		B0 B8 C0 C8 
			   		D0 D8 E0 E7 
			   		EF F8 FF 03 
			   		F3 C0 00 83
			   		0C 30 C0 00 
			   		00 08 0D 15 
			   		1C 24 2E 34 
			   		3F 48 50 58 
			   		60 69 70 78
			   		80 88 90 98 
			   		A0 A8 B0 B8 
			   		C0 C8 D0 D8 
			   		E0 E7 EF F8 
			   		FF 03 F3 C0
			   		00 83 0C 30 
			   		C0 00 00 08 
			   		10 18 20 28
                    			30 38 40 48
                    			50 58 60 68
                    			70 78 80 88
                    			90 98 A0 A8
                    			B0 B8 C0 C8
                    			D0 D8 E0 E8
					F0 F3 F6 1C
			   		31 97 E7 AB 
			   		82 2E 9F 80 
				//39 01 00 00 00 00 02
				//	CC 02
				//39 01 00 00 00 00 05
				//	B6 00 7E 00 7E
				//39 01 00 00 00 00 03
				//	C0 43 17
				39 01 00 00 01 00 03
					C9 0F 01
				//39 01 00 00 00 00 02
				//	36 00
				39 01 00 00 01 00 05
					B6 00 87 00 87
				39 01 00 00 00 00 02
					CC 02
				39 01 00 00 00 00 04
					B7 00 00 50
				39 01 00 00 00 00 02
					E6 01
				39 01 00 00 00 00 02
					E4 00
				39 01 00 00 00 00 02
					35 00
				39 01 00 00 00 00 02
					53 24
				39 01 00 00 00 00 02
					55 02
 				05 01 00 00 78 00 02
 					11 00
				39 01 00 00 00 00 02
					C6 EC
 				05 01 00 00 14 00 02
					29 00
				15 01 00 00 00 00 02
					51 00 
				];
		qcom,mdss-dsi-off-command = [05 01 00 00 02 00 02 28 00
				 05 01 00 00 79 00 02 10 00];
		qcom,mdss-dsi-on-command-state = "dsi_lp_mode";
		qcom,mdss-dsi-off-command-state = "dsi_hs_mode";
		qcom,mdss-dsi-h-sync-pulse = <0>;
		qcom,mdss-dsi-traffic-mode = "burst_mode";
		qcom,mdss-dsi-bllp-eof-power-mode;
		qcom,mdss-dsi-bllp-power-mode;
        //qcom,mdss-dsi-hfp-power-mode;
        //qcom,mdss-dsi-hsa-power-mode;
        qcom,mdss-dsi-hbp-power-mode;
        qcom,mdss-dsi-lp11-init;
		qcom,mdss-dsi-lane-0-state;
		qcom,mdss-dsi-lane-1-state;
		//qcom,mdss-dsi-lane-2-state;
		//qcom,mdss-dsi-lane-3-state;
		/*qcom,mdss-dsi-panel-timings = [e1 37 25 00 67 6b 2a 3a 59 03 04 00];*/
		//qcom,mdss-dsi-panel-timings = [8B 1E 14 00 44 48 18 22 19 03 04 00];
		qcom,mdss-dsi-panel-timings = [88 1C 12 00 42 44 18 20 16 03 04 00];

		qcom,mdss-dsi-t-clk-post = <0x04>;
		qcom,mdss-dsi-t-clk-pre = <0x28>;
		qcom,mdss-dsi-bl-min-level = <1>;
		qcom,mdss-dsi-bl-max-level = <255>;
		qcom,mdss-dsi-dma-trigger = "trigger_sw";
		qcom,mdss-dsi-mdp-trigger = "none";
		qcom,mdss-dsi-bl-pmic-control-type = "bl_ctrl_dcs";
		qcom,mdss-dsi-reset-sequence = <1 10>, <0 20>, <1 10>;
		qcom,mdss-pan-physical-width-dimension = <61>;
		qcom,mdss-pan-physical-height-dimension = <110>;
		//qcom,cont-splash-enabled;
	};
};
