/* Copyright (c) 2013-2014, The Linux Foundation. All rights reserved.
 *
 * This program is free software; you can redistribute it and/or modify
 * it under the terms of the GNU General Public License version 2 and
 * only version 2 as published by the Free Software Foundation.
 *
 * This program is distributed in the hope that it will be useful,
 * but WITHOUT ANY WARRANTY; without even the implied warranty of
 * MERCHANTABILITY or FITNESS FOR A PARTICULAR PURPOSE.  See the
 * GNU General Public License for more details.
 */

/*---------------------------------------------------------------------------
 * This file is autogenerated file using gcdb parser. Please do not edit it.
 * Update input XML file to add a new entry or update variable in this file
 * VERSION = "1.0"
 *---------------------------------------------------------------------------*/
&mdss_mdp {
	dsi_gl_qhp_vid: qcom,mdss_dsi_nt35517_qhd_video {
		qcom,mdss-dsi-panel-name = "nt35517 qhd video mode dsi panel";
		qcom,mdss-dsi-panel-controller = <&mdss_dsi0>;
		qcom,mdss-dsi-panel-type = "dsi_video_mode";
		qcom,mdss-dsi-panel-destination = "display_1";
		qcom,mdss-dsi-panel-framerate = <60>;
		qcom,mdss-dsi-virtual-channel-id = <0>;
		qcom,mdss-dsi-stream = <0>;
		qcom,mdss-dsi-panel-width = <540>;
		qcom,mdss-dsi-panel-height = <960>;
		qcom,mdss-dsi-h-front-porch = <47>;
		qcom,mdss-dsi-h-back-porch = <47>;
		qcom,mdss-dsi-h-pulse-width = <47>;
		qcom,mdss-dsi-h-sync-skew = <0>;
		qcom,mdss-dsi-v-back-porch = <5>;
		qcom,mdss-dsi-v-front-porch = <10>;
		qcom,mdss-dsi-v-pulse-width = <2>;
		qcom,mdss-dsi-h-left-border = <0>;
		qcom,mdss-dsi-h-right-border = <0>;
		qcom,mdss-dsi-v-top-border = <0>;
		qcom,mdss-dsi-v-bottom-border = <0>;
		qcom,mdss-dsi-bpp = <24>;
		qcom,mdss-dsi-underflow-color = <0xff>;
		qcom,mdss-dsi-border-color = <0>;
		qcom,mdss-dsi-on-command = [
			39 01 00 00 00 00 06 F0 55 AA 52 08 00
			39 01 00 00 00 00 02 BC 00       
			39 01 00 00 00 00 04 CC 03 00 00
			39 01 00 00 00 00 06 B0 00 0C 40 3C 3C 
			39 01 00 00 00 00 03 B1 FC 00
			39 01 00 00 00 00 02 B3 80
			39 01 00 00 00 00 02 B6 08          
			39 01 00 00 00 00 03 B7 00 00
			39 01 00 00 00 00 02 BA 01
			39 01 00 00 00 00 06 BD 01 41 10 37 01
			39 01 00 00 00 00 06 F0 55 AA 52 08 01
			39 01 00 00 00 00 04 B0 0A 0A 0A                  
			39 01 00 00 00 00 04 B6 43 43 43                  
			39 01 00 00 00 00 04 B1 0A 0A 0A                  
			39 01 00 00 00 00 04 B7 22 22 22                  
			39 01 00 00 00 00 04 B2 03 03 03                  
			39 01 00 00 00 00 04 B8 33 33 33                  
			39 01 00 00 00 00 04 B3 0A 0A 0A                  
			39 01 00 00 00 00 04 B9 24 24 24                  
			39 01 00 00 00 00 04 B4 0A 0A 0A                  
			39 01 00 00 00 00 04 BA 24 24 24                 
			39 01 00 00 00 00 04 B5 07 07 07                  
			39 01 00 00 00 00 04 BC 00 60 00                  
			39 01 00 00 00 00 04 BD 00 60 00                  
			39 01 00 00 00 00 02 BE 4A                       
			39 01 00 00 00 00 02 BF 3D                        
			39 01 00 00 00 00 11 D1 00 20 00 2E 00 48 00 5D 00 70 00 8F 00 AB 00 D7            
			39 01 00 00 00 00 11 D2 00 FC 01 39 01 6A 01 B6 01 F5 01 F6 02 30 02 6F            
			39 01 00 00 00 00 11 D3 02 90 02 C9 02 EA 03 1D 03 3C 03 69 03 80 03 AE            
			39 01 00 00 00 00 05 D4 03 F8 03 FF
			39 01 00 00 00 00 11 D5 00 20 00 2E 00 48 00 5D 00 70 00 8F 00 AB 00 D7            
			39 01 00 00 00 00 11 D6 00 FC 01 39 01 6A 01 B6 01 F5 01 F6 02 30 02 6F            
			39 01 00 00 00 00 11 D7 02 90 02 C9 02 EA 03 1D 03 3C 03 69 03 80 03 AE           
			39 01 00 00 00 00 05 D8 03 F8 03 FF                                    
			39 01 00 00 00 00 11 D9 00 20 00 2E 00 48 00 5D 00 70 00 8F 00 AB 00 D7          
			39 01 00 00 00 00 11 DD 00 FC 01 39 01 6A 01 B6 01 F5 01 F6 02 30 02 6F          
			39 01 00 00 00 00 11 DE 02 90 02 C9 02 EA 03 1D 03 3C 03 69 03 80 03 AE        
			39 01 00 00 00 00 05 DF 03 F8 03 FF                                    
			39 01 00 00 00 00 11 E0 00 20 00 2E 00 48 00 5D 00 70 00 8F 00 AB 00 D7            
			39 01 00 00 00 00 11 E1 00 FC 01 39 01 6A 01 B6 01 F5 01 F6 02 30 02 6F          
			39 01 00 00 00 00 11 E2 02 90 02 C9 02 EA 03 1D 03 3C 03 69 03 80 03 AE          
			39 01 00 00 00 00 05 E3 03 F8 03 FF                                    
			39 01 00 00 00 00 11 E4 00 20 00 2E 00 48 00 5D 00 70 00 8F 00 AB 00 D7            
			39 01 00 00 00 00 11 E5 00 FC 01 39 01 6A 01 B6 01 F5 01 F6 02 30 02 6F           
			39 01 00 00 00 00 11 E6 02 90 02 C9 02 EA 03 1D 03 3C 03 69 03 80 03 AE        
			39 01 00 00 00 00 05 E7 03 F8 03 FF                                    
			39 01 00 00 00 00 11 E8 00 20 00 2E 00 48 00 5D 00 70 00 8F 00 AB 00 D7           
			39 01 00 00 00 00 11 E9 00 FC 01 39 01 6A 01 B6 01 F5 01 F6 02 30 02 6F          
			39 01 00 00 00 00 11 EA 02 90 02 C9 02 EA 03 1D 03 3C 03 69 03 80 03 AE        
			39 01 00 00 00 00 05 EB 03 F8 03 FF                                             
            15 01 00 00 00 00 02 51 00
            39 01 00 00 00 00 02 53 2C
            39 01 00 00 00 00 02 55 02
			05 01 00 00 78 00 01 11                
			05 01 00 00 14 00 01 29                
				];
		qcom,mdss-dsi-off-command = [39 01 00 00 00 00 02 53 00 
            05 01 00 00 02 00 02 28 00
            05 01 00 00 79 00 02 10 00];
		qcom,mdss-dsi-on-command-state = "dsi_lp_mode";
		qcom,mdss-dsi-off-command-state = "dsi_hs_mode";
		qcom,mdss-dsi-h-sync-pulse = <0>;
		qcom,mdss-dsi-traffic-mode = "burst_mode";
		qcom,mdss-dsi-bllp-eof-power-mode;
		qcom,mdss-dsi-bllp-power-mode;
		qcom,mdss-dsi-lane-0-state;
		qcom,mdss-dsi-lane-1-state;
		//qcom,mdss-dsi-lane-2-state;
		//qcom,mdss-dsi-lane-3-state;
		qcom,mdss-dsi-panel-timings = [e1 37 25 00 67 6b 2a 3a 59 03 04 00];
		qcom,mdss-dsi-t-clk-post = <0x04>;
		qcom,mdss-dsi-t-clk-pre = <0x1b>;
		qcom,mdss-dsi-bl-min-level = <1>;
		qcom,mdss-dsi-bl-max-level = <255>;
		qcom,mdss-dsi-dma-trigger = "trigger_sw";
		qcom,mdss-dsi-mdp-trigger = "none";
		qcom,mdss-dsi-bl-pmic-control-type = "bl_ctrl_dcs";
		qcom,mdss-dsi-reset-sequence = <1 20>, <0 200>, <1 20>;
		qcom,mdss-pan-physical-width-dimension = <61>;
		qcom,mdss-pan-physical-height-dimension = <110>;
		//qcom,cont-splash-enabled;
	};
};
